#include <SPI.h>
#include <Wire.h>
#include <Adafruit_SSD1306.h>
#include "ClosedCube_HDC1080.h"

// Relay pins
#define FANPIN 6
#define MISTERPIN 9

// Rotary Encoder Inputs
#define CLK 2
#define DT 3
#define SW 4

// RH and temp sensor input
ClosedCube_HDC1080 hdc1080;

#define SCREEN_WIDTH 128 // OLED display width, in pixels
#define SCREEN_HEIGHT 64 // OLED display height, in pixels

// Declaration for an SSD1306 display connected to I2C (SDA, SCL pins)
#define OLED_RESET -1 // Reset pin # (or -1 if sharing Arduino reset pin)
Adafruit_SSD1306 display(SCREEN_WIDTH, SCREEN_HEIGHT, &Wire, OLED_RESET);

int userSetHumidityValue = 80;
int currentStateCLK;
int lastStateCLK;
unsigned long displayCounterUntil = 0;
bool showCounter = false;

bool showTimer = false; 
unsigned long displayTimerUntil = 10000;
unsigned long previousTimerUntil;

const unsigned char PROGMEM mushroom_bmp[] = {
  0x00, 0x00, 0x00, 0x00, 0x00, 0x00, 0x00, 0x00, 0x00, 0x00, 0x00, 0x00, 0x00, 0x00, 0x00, 0x00, 
  0x00, 0x00, 0x00, 0x00, 0x00, 0x00, 0x00, 0x00, 0x00, 0x00, 0x00, 0x00, 0x00, 0x00, 0x00, 0x00, 
  0x00, 0x00, 0x00, 0x00, 0x00, 0x00, 0x00, 0x00, 0x00, 0x00, 0x00, 0x00, 0x00, 0x00, 0x00, 0x00, 
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  0x00, 0x00, 0x00, 0x00, 0x00, 0x00, 0x00, 0x00, 0x00, 0x00, 0x00, 0x00, 0x00, 0x00, 0x00, 0x00
};

void setup() {
  // Setup Serial Monitor
  Serial.begin(115200);
  
  // Set encoder pins as inputs
  pinMode(CLK, INPUT);
  pinMode(DT, INPUT);
  pinMode(SW, INPUT_PULLUP);

  // Set relay pins up
  pinMode(FANPIN, OUTPUT);
  pinMode(MISTERPIN, OUTPUT);
  digitalWrite(FANPIN, LOW);
  digitalWrite(MISTERPIN, LOW);

  if(!display.begin(SSD1306_SWITCHCAPVCC, 0x3C)) { 
    Serial.println(F("SSD1306 allocation failed"));
    for(;;); // Don't proceed, loop forever
  }

  display.clearDisplay();

  // Set text size and color
  display.setTextSize(0.2);      // Set text size to 1 (default size)
  display.setTextColor(WHITE); // Set text color to white

  // Set cursor position and print text
  display.setCursor(0, SCREEN_HEIGHT - 8);
  display.print(" ");
  display.print("Made by James Wilson");

  // Draw the bitmap
  display.drawBitmap(32, -10, mushroom_bmp, 128, 64, WHITE);

  // Update the display
  display.display();
  delay(3000);

  // Read the initial state of CLK
  lastStateCLK = digitalRead(CLK);

  hdc1080.begin(0x40);

  attachInterrupt(digitalPinToInterrupt(CLK), readRotaryEncoder, CHANGE);
  attachInterrupt(digitalPinToInterrupt(DT), readRotaryEncoder, CHANGE);
}




void readRotaryEncoder() {
  // Read the current state of CLK
  currentStateCLK = digitalRead(CLK);

  // If last and current state of CLK are different, then pulse occurred
  // React to only 1 state change to avoid double count
  if (currentStateCLK != lastStateCLK && currentStateCLK == 1) {
    // If the DT state is different than the CLK state then
    if (digitalRead(DT) != currentStateCLK) {
      // To keep the values from 0 to 100
      if (userSetHumidityValue < 100) {
        userSetHumidityValue++;
      }
    } else {
      if (userSetHumidityValue > 0) {
        userSetHumidityValue--;
      }
    }

    // Set flag to show userSetHumidityValue and update the timer
    showCounter = true;
    displayCounterUntil = millis() + 2000; // Show userSetHumidityValue for 2 seconds
  }

  // Remember last CLK state
  lastStateCLK = currentStateCLK;
}

void drawLabelWithBox(int x, int y, String label, float value, String unit) {
  // Set text size and color for the label
  display.setTextSize(1);
  display.setTextColor(SSD1306_WHITE);

  // Print the label
  display.setCursor(x, y);
  display.print(label);

  // Create the value string
  String valueString = String(value, 1) + unit;

  // Calculate text width and height of the value string
  int16_t x1, y1;
  uint16_t w, h;
  display.getTextBounds(valueString, 0, 0, &x1, &y1, &w, &h);

  // Define the box dimensions with a gap around the text
  int boxPadding = 4; // Padding around the text inside the box
  int valueX = x + 50; // X position of the value with a gap of 50 pixels
  int valueY = y;
  int boxX = valueX - boxPadding;
  int boxY = valueY - boxPadding;
  int boxWidth = w + 9 * boxPadding;
  int boxHeight = h + 4 * boxPadding;

  // Draw the box around the text
  display.drawRect(boxX, boxY, boxWidth, boxHeight, SSD1306_WHITE);

  // Set text size for the value
  display.setTextSize(2);
  display.setCursor(valueX, valueY);

  // Print the value inside the box
  display.print(valueString);

  // Reset text size to 1
  display.setTextSize(1);
}

void displayCounterValue() {
  display.clearDisplay();
  int textWidth = userSetHumidityValue < 10 ? 28 : userSetHumidityValue < 100 ? 40 : 65; 
  int posX = (SCREEN_WIDTH - textWidth) / 2;
  int posY = (SCREEN_HEIGHT - 16) / 2; // Centered vertically
  display.setCursor(posX, posY);
  display.setTextSize(3);
  display.print(userSetHumidityValue);  // Print the user-chosen value
  display.print("%");
  display.display();
}

// void displayCounterTimer(){
//   int countDownTime = millis() - previousTimerUntil;
//   display.clearDisplay();
//   int textWidth = countDownTime < 10 ? 28 : userSetHumidityValue < 100 ? 40 : 65; // Adjust based on number of digits
//   int posX = (SCREEN_WIDTH - textWidth) / 2;
//   int posY = (SCREEN_HEIGHT - 16) / 2; // Centered vertically
//   display.setCursor(posX, posY);
//   display.setTextSize(3);
//   display.print(countDownTime);  // Print the user-chosen value
//   display.display();
// }


void loop() {
  float tempC = hdc1080.readTemperature();
  float humidity = hdc1080.readHumidity();
  int buttonState = digitalRead(SW);


  if (showCounter) {
    displayCounterValue();
    if (millis() > displayCounterUntil) {
      showCounter = false;
    }
  }
  // } else if(showTimer){
  //   displayCounterTimer();
  //   if(millis() > (millis() + displayTimerUntil)){
  //     showTimer = false; 
  //   }
  //   previousTimerUntil = millis();
  // } 
  else {
    // Clear the display buffer
    display.clearDisplay();
    // Draw the labels with values and units
    drawLabelWithBox(0, 10, "Temp:", tempC, "C");
    drawLabelWithBox(0, 40, "RH:", humidity, "%");
    // Update the display with the drawn content
    display.display();
  }

  // Setting relays to turn on when humidity is lower than the userSetHumidityValue from rotary encoder
   if (humidity < userSetHumidityValue) {
    digitalWrite(FANPIN, HIGH);
    digitalWrite(MISTERPIN, HIGH);
  } else {
    digitalWrite(FANPIN, LOW);
    digitalWrite(MISTERPIN, LOW);
  }

  // Put in a slight delay to help debounce the reading
  delay(100);
}

